## config/boards/shields/crabulik_console/Kconfig.defconfig
```kconfig
if SHIELD_CRABULIK_CONSOLE

config ZMK_KEYBOARD_NAME
    default "CrabulikConsole"

endif
```

## config/boards/shields/crabulik_console/Kconfig.shield
```kconfig
config SHIELD_CRABULIK_CONSOLE
    def_bool $(shields_list_contains,crabulik_console)
```

## modules/zmk-adc-dpad/Kconfig
```kconfig
config CRABULIK_ADC_DPAD
    bool "Resistor-ladder 5-way d-pad read on one ADC channel"
    default n
    select ADC
    help
      Reads a passive resistor-ladder 5-way control (e.g. a CaddxFPV OSD menu
      board) on a single ADC channel and sends a keycode per direction. Each
      direction pulls the analog line to a distinct voltage band; the driver
      thresholds the reading and emits the mapped key.

      Requires an ADC channel node labelled `dpad_chan` in the shield overlay and
      an external pull-up resistor from the signal wire to 3.3V. See
      modules/zmk-adc-dpad/README.md for wiring, the overlay snippet, and the
      calibration procedure.

config CRABULIK_ADC_DPAD_LOG_MV
    bool "Log measured d-pad millivolts (calibration aid)"
    depends on CRABULIK_ADC_DPAD
    default n
    help
      Logs the measured voltage and selected band on every poll. Build a logging
      firmware, press each direction, and read the values to set the thresholds.
```

## modules/zmk-layout-indicators/Kconfig
```kconfig
config ZMK_LAYOUT_INDICATORS
    bool "Layout indicator LEDs controlled by a paired host over BLE"
    depends on ZMK_BLE
    default y
    help
      Registers a custom BLE GATT service with one writable, encryption-required
      characteristic. A paired host (the companion app) writes a single byte to
      select which keyboard-layout indicator LED is lit:

          0 = US  (led_us on,  led_ua off)
          1 = UA  (led_ua on,  led_us off)
          2 = off / unknown (both off)

      Requires the board to define `led_us` and `led_ua` GPIO nodelabels (see the
      crabulik_console shield overlay).
```
